## conf/layer.conf
```bitbake
# We have a conf and classes directory, add to BBPATH
BBPATH .= ":${LAYERDIR}"

# We have recipes-* directories, add to BBFILES
BBFILES += "${LAYERDIR}/recipes-*/*/*.bb \
            ${LAYERDIR}/recipes-*/*/*.bbappend"

BBFILE_COLLECTIONS += "meta-customQt"
BBFILE_PATTERN_meta-customQt = "^${LAYERDIR}/"
BBFILE_PRIORITY_meta-customQt = "7"

LAYERDEPENDS_meta-customQt = "core"
LAYERSERIES_COMPAT_meta-customQt = "kirkstone"
```

## conf/machine/custombeaglebone.conf
```bitbake
require conf/machine/include/ti-soc.inc
SOC_FAMILY:append = ":ti33x"
DEFAULTTUNE = "armv7athf-neon"
require conf/machine/include/arm/armv7a/tune-cortexa8.inc

PREFERRED_PROVIDER_virtual/kernel ?= "linux-ti-staging"

KERNEL_DEVICETREE = "am335x-boneblack.dtb"

PREFERRED_PROVIDER_virtual/bootloader = "u-boot-ti-staging"

UBOOT_ARCH = "arm"

UBOOT_MACHINE = "am335x_evm_config"

UBOOT_ENTRYPOINT = "0x80008000"
UBOOT_LOADADDRESS = "0x80008000"

KERNEL_IMAGETYPE = "zImage"
SERIAL_CONSOLES = "115200 ttyS0"

# List common SoC features, may need to add touchscreen for specific machines
MACHINE_FEATURES = "kernel26 apm usbgadget usbhost vfat ext2 alsa"

IMAGE_FSTYPES += "tar.xz"
IMAGE_BOOT_FILES = "u-boot.img"
EXTRA_IMAGEDEPENDS += "u-boot"
```
